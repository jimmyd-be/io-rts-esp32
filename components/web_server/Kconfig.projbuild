## components/web_server/Kconfig.projbuild
```kconfig
menu "OTA Update"

    config OTA_API_KEY
        string "OTA API key (X-OTA-Key header)"
        default ""
        help
            Secret key required in the X-OTA-Key HTTP header to authorize
            firmware uploads via POST /api/ota. Set a unique value here so
            the same key works across machines without needing serial access.
            If left empty, a random key is generated on first boot and stored
            in NVS — retrieve it once from the serial boot log.

endmenu

menu "Web Server"

    config WEB_HTTPS_ENABLED
        bool "Enable HTTPS with a self-signed certificate"
        depends on WEB_ENABLED
        default y
        help
            Start an HTTPS server on port 443 in addition to the HTTP server on
            port 80. The bundled certificate is self-signed, so browsers will
            show a trust warning unless you add the certificate to your trust store.

endmenu
```
